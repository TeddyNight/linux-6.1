## arch/riscv/crypto/Kconfig
```kconfig
# SPDX-License-Identifier: GPL-2.0

menu "Accelerated Cryptographic Algorithms for CPU (riscv)"

config CRYPTO_AES_RISCV64
	tristate "Ciphers: AES, modes: ECB, CBC, CTR, XTS"
	depends on 64BIT && RISCV_ISA_V && TOOLCHAIN_HAS_VECTOR_CRYPTO
	select CRYPTO_ALGAPI
	select CRYPTO_LIB_AES
	select CRYPTO_SKCIPHER
	help
	  Block cipher: AES cipher algorithms
	  Length-preserving ciphers: AES with ECB, CBC, CTR, XTS

	  Architecture: riscv64 using:
	  - Zvkned vector crypto extension
	  - Zvbb vector extension (XTS)
	  - Zvkb vector crypto extension (CTR)
	  - Zvkg vector crypto extension (XTS)

config CRYPTO_CHACHA_RISCV64
	tristate "Ciphers: ChaCha"
	depends on 64BIT && RISCV_ISA_V && TOOLCHAIN_HAS_VECTOR_CRYPTO
	select CRYPTO_SKCIPHER
	select CRYPTO_LIB_CHACHA_GENERIC
	select CRYPTO_ARCH_HAVE_LIB_CHACHA
	help
	  Length-preserving ciphers: ChaCha20 stream cipher algorithm

	  Architecture: riscv64 using:
	  - V vector extension
	  - Zvkb vector crypto extension

config CRYPTO_POLY1305_RISCV
	tristate "Ciphers: Poly1305"
	select CRYPTO_ARCH_HAVE_LIB_POLY1305
	help
	  Poly1305 authenticator algorithm (RFC7539)

	  Architecture: riscv64 using:
	  - V vector extension

endmenu
```
